## apps/Kconfig
```kconfig
#
# For a description of the syntax of this configuration file,
# see the file kconfig-language.txt in the tools repository.
#
menu "Shell"
source "apps/shell/Kconfig"
endmenu

menu "System Libraries"
source "apps/system/Kconfig"
endmenu

menu "Examples"
source "apps/examples/Kconfig"
endmenu
```

## apps/examples/Kconfig
```kconfig
#
# For a description of the syntax of this configuration file,
# see the file kconfig-language.txt in the tools repository.
#

source "apps/examples/hello/Kconfig"
```

## apps/examples/hello/Kconfig
```kconfig
#
# For a description of the syntax of this configuration file,
# see the file kconfig-language.txt in the tools repository.
#


config EXAMPLES_HELLO
	tristate "\"Hello, World!\" example"
	default n
	---help---
		Enable the \"Hello, World!\" example

if EXAMPLES_HELLO

endif #EXAMPLES_HELLO
```

## arch/arm/Kconfig
```kconfig
#
# For a description of the syntax of this configuration file,
# see the file kconfig-language.txt in the tools repository.
#

if ARCH_ARM
comment "ARM Options"

choice
	prompt "ARM MCU selection"
	default ARCH_CHIP_STM32

config ARCH_CHIP_STM32
	bool "STMicro STM32 F1/F2/F3/F4/L1"
	select ARCH_HAVE_CMNVECTOR
	select ARCH_HAVE_MPU
	select ARCH_HAVE_FETCHADD
	select ARCH_HAVE_I2CRESET
	select ARCH_HAVE_HEAPCHECK
	select ARCH_HAVE_PROGMEM
	select ARCH_HAVE_SPI_BITORDER
	select ARCH_HAVE_TICKLESS
	select ARCH_HAVE_TIMEKEEPING
	select ARM_HAVE_MPU_UNIFIED
	select ARMV7M_HAVE_STACKCHECK
	---help---
		STMicro STM32 architectures (ARM Cortex-M3/4).

config ARCH_CHIP_STM32F0
	bool "STMicro STM32 F0"
	select ARCH_CORTEXM0
	select ARCH_HAVE_CMNVECTOR
	---help---
		STMicro STM32 architectures (ARM Cortex-M0).

config ARCH_CHIP_STM32F7
	bool "STMicro STM32 F7"
	select ARCH_HAVE_CMNVECTOR
	select ARCH_CORTEXM7
	select ARCH_HAVE_MPU
	select ARCH_HAVE_FETCHADD
	select ARCH_HAVE_I2CRESET
	select ARCH_HAVE_HEAPCHECK
	select ARCH_HAVE_SPI_BITORDER
	select ARM_HAVE_MPU_UNIFIED
	select ARMV7M_CMNVECTOR
	select ARMV7M_HAVE_STACKCHECK
	---help---
		STMicro STM32 architectures (ARM Cortex-M7).

config ARCH_CHIP_STM32L4
	bool "STMicro STM32 L4"
	select ARCH_CORTEXM4
	select ARCH_HAVE_CMNVECTOR
	select ARCH_HAVE_I2CRESET
	select ARCH_HAVE_HEAPCHECK
	select ARCH_HAVE_MPU
	select ARCH_HAVE_PROGMEM
	select ARCH_HAVE_SPI_BITORDER
	select ARCH_HAVE_TICKLESS
	select ARM_HAVE_MPU_UNIFIED
	select ARMV7M_CMNVECTOR
	select ARMV7M_HAVE_STACKCHECK
	---help---
		STMicro STM32 architectures (ARM Cortex-M4).

config ARCH_CHIP_STR71X
	bool "STMicro STR71x"
	select ARCH_ARM7TDMI
	select ARCH_HAVE_LOWVECTORS
	---help---
		STMicro STR71x architectures (ARM7TDMI).

endchoice

config ARCH_ARM7TDMI
	bool
	default n
	---help---
		The Arm7TDMI-S is an excellent workhorse processor capable of a wide
		array of applications. Traditionally used in mobile handsets, the
		processor is now broadly in many non-mobile applications.

config ARCH_ARM920T
	bool
	default n
	select ARCH_HAVE_MMU
	select ARCH_USE_MMU
	---help---
		The ARM9 processor family is built around the ARM9TDMI processor and
		incorporates the 16-bit Thumb instruction set. The ARM9 Thumb family
		includes the ARM920T and ARM922T cached processor macrocells:

		- Dual 16k caches for applications running Symbian OS, Palm OS,
		  Linux and Windows CE,
		- Dual 8k caches for applications running Symbian OS, Palm OS, Linux
		  and Windows CE Applications

config ARCH_ARM926EJS
	bool
	default n
	select ARCH_HAVE_MMU
	select ARCH_USE_MMU
	---help---
		Arm926EJ-S is the entry point processor capable of supporting full
		Operating Systems including Linux, WindowsCE, and Symbian.

		The ARM9E processor family enables single processor solutions for
		microcontroller, DSP and Java applications. The ARM9E family of
		products are DSP-enhanced 32-bit RISC processors, for applications
		requiring a mix of DSP and microcontroller performance. The family
		includes the ARM926EJ-S, ARM946E-S, ARM966E-S, and ARM968E-S
		processor macrocells. They include signal processing extensions to
		enhance 16-bit fixed point performance using a single-cycle 32 x 16
		multiply-accumulate (MAC) unit, and implement the 16-bit Thumb
		instruction set. The ARM926EJ-S processor also includes ARM Jazelle
		technology which enables the direct execution of Java bytecodes in
		hardware.

config ARCH_ARM1136J
	bool
	default n
	select ARCH_HAVE_MMU
	select ARCH_USE_MMU
	---help---
		Arm1136J(F)-S is very similar to Arm926EJ-S, but includes an
		extended pipeline, basic SIMD (Single Instruction Multiple Data)
		instructions, and improved frequency and performance.

config ARCH_ARM1156T2
	bool
	default n
	select ARCH_HAVE_MMU
	select ARCH_USE_MMU
	---help---
		Arm1156T2(F)-S is the highest-performance processor in the real-time
		Classic Arm family.

config ARCH_ARM1176JZ
	bool
	default n
	select ARCH_HAVE_MMU
	select ARCH_USE_MMU
	---help---
		Arm1176JZ(F)-S is the highest-performance single-core processor in
		the Classic Arm family. It also introduced TrustZone technology to
		enable secure execution outside of the reach of malicious code.

config ARCH_CORTEXM0
	bool
	default n
	select ARCH_HAVE_IRQPRIO
	select ARCH_HAVE_RESET

config ARCH_CORTEXM23
	bool
	default n

config ARCH_CORTEXM3
	bool
	default n
	select ARCH_HAVE_IRQPRIO
	select ARCH_HAVE_RAMVECTORS
	select ARCH_HAVE_HIPRI_INTERRUPT
	select ARCH_HAVE_RESET

config ARCH_CORTEXM33
	bool
	default n

config ARCH_CORTEXM4
	bool
	default n
	select ARCH_HAVE_IRQPRIO
	select ARCH_HAVE_RAMVECTORS
	select ARCH_HAVE_HIPRI_INTERRUPT
	select ARCH_HAVE_RESET

config ARCH_CORTEXM7
	bool
	default n
	select ARCH_HAVE_FPU
	select ARCH_HAVE_IRQPRIO
	select ARCH_HAVE_RAMVECTORS
	select ARCH_HAVE_HIPRI_INTERRUPT
	select ARCH_HAVE_RESET
	select ARCH_HAVE_COHERENT_DCACHE if ELF || MODULE

config ARCH_CORTEXA5
	bool
	default n
	select ARCH_HAVE_MMU
	select ARCH_USE_MMU
	select ARCH_HAVE_COHERENT_DCACHE if ELF || MODULE

config ARCH_CORTEXA8
	bool
	default n
	select ARCH_HAVE_MMU
	select ARCH_USE_MMU
	select ARCH_HAVE_COHERENT_DCACHE if ELF || MODULE

config ARCH_CORTEXA9
	bool
	default n
	select ARCH_HAVE_MMU
	select ARCH_USE_MMU
	select ARCH_HAVE_COHERENT_DCACHE if ELF || MODULE

config ARCH_CORTEXR4
	bool
	default n
	select ARCH_HAVE_MPU
	select ARCH_HAVE_COHERENT_DCACHE if ELF || MODULE

config ARCH_CORTEXR4F
	bool
	default n
	select ARCH_HAVE_MPU
	select ARCH_HAVE_FPU
	select ARCH_HAVE_COHERENT_DCACHE if ELF || MODULE

config ARCH_CORTEXR5
	bool
	default n
	select ARCH_HAVE_MPU
	select ARCH_HAVE_COHERENT_DCACHE if ELF || MODULE

config ARCH_CORTEXR5F
	bool
	default n
	select ARCH_HAVE_MPU
	select ARCH_HAVE_FPU
	select ARCH_HAVE_COHERENT_DCACHE if ELF || MODULE

config ARCH_CORTEXR7
	bool
	default n
	select ARCH_HAVE_MPU
	select ARCH_HAVE_COHERENT_DCACHE if ELF || MODULE

config ARCH_CORTEXR7F
	bool
	default n
	select ARCH_HAVE_MPU
	select ARCH_HAVE_FPU
	select ARCH_HAVE_COHERENT_DCACHE if ELF || MODULE

config ARCH_FAMILY
	string
	default "arm"		if ARCH_ARM7TDMI || ARCH_ARM926EJS || ARCH_ARM920T
	default "armv6-m"	if ARCH_CORTEXM0
	default "armv7-a"	if ARCH_CORTEXA5 || ARCH_CORTEXA8 || ARCH_CORTEXA9
	default "armv7-m"	if ARCH_CORTEXM3 || ARCH_CORTEXM4 || ARCH_CORTEXM7
	default "armv7-r"	if ARCH_CORTEXR4 || ARCH_CORTEXR4F || ARCH_CORTEXR5 || ARCH_CORTEXR5F || ARCH_CORTEX74 || ARCH_CORTEXR7F

config ARCH_CHIP
	string
	default "stm32"		if ARCH_CHIP_STM32
	default "stm32f0"	if ARCH_CHIP_STM32F0
	default "stm32f7"	if ARCH_CHIP_STM32F7
	default "stm32l4"	if ARCH_CHIP_STM32L4

config ARMV7M_USEBASEPRI
	bool "Use BASEPRI Register"
	default n
	depends on ARCH_CORTEXM3 || ARCH_CORTEXM4 || ARCH_CORTEXM7
	---help---
		Use the BASEPRI register to enable and disable interrupts. By
		default, the PRIMASK register is used for this purpose. This
		usually results in hardfaults when supervisor calls are made.
		Though, these hardfaults are properly handled by the RTOS, the
		hardfaults can confuse some debuggers. With the BASEPRI
		register, these hardfaults, will be avoided. For more details see
		http://www.nuttx.org/doku.php?id=wiki:nxinternal:svcall

config ARCH_HAVE_CMNVECTOR
	bool

config ARMV7M_CMNVECTOR
	bool "Use common ARMv7-M vectors"
	default n
	depends on ARCH_HAVE_CMNVECTOR
	---help---
		Some architectures use their own, built-in vector logic.  Some use only
		the common vector logic.  Some can use either their own built-in vector
		logic or the common vector logic.  This applies only to ARMv7-M
		architectures.

config ARMV7M_LAZYFPU
	bool "Lazy FPU storage"
	default n
	depends on ARCH_HAVE_CMNVECTOR
	---help---
		There are two forms of the common vector logic.  There are pros and
		cons to each option:

		1) The standard common vector logic exploits features of the ARMv7-M
		   architecture to save the all of floating registers on entry into
		   each interrupt and then to restore the floating registers when
		   the interrupt returns.  The primary advantage to this approach is
		   that floating point operations are available in interrupt
		   handling logic.  Since the volatile registers are preserved,
		   operations on the floating point registers by interrupt handling
		   logic has no ill effect.  The downside is, of course, that more
		   stack operations are required on each interrupt to save and store
		   the floating point registers.  Because of the some special
		   features of the ARMv-M, this is not as much overhead as you might
		   expect, but overhead nonetheless.

		2) The lazy FPU common vector logic does not save or restore
		   floating point registers on entry and exit from the interrupt
		   handler. Rather, the floating point registers are not restored
		   until it is absolutely necessary to do so when a context switch
		   occurs and the interrupt handler will be returning to a different
		   floating point context.  Since floating point registers are not
		   protected, floating point operations must not be performed in
		   interrupt handling logic.  Better interrupt performance is be
		   expected, however.

		By default, the "standard" common vector logic is build.  This
		option selects the alternate lazy FPU common vector logic.

config ARCH_HAVE_FPU
	bool
	default n

config ARCH_HAVE_DPFPU
	bool
	default n

config ARCH_FPU
	bool "FPU support"
	default y
	depends on ARCH_HAVE_FPU
	---help---
		Build in support for the ARM Cortex-M4 Floating Point Unit (FPU).
		Check your chip specifications first; not all Cortex-M4 chips
		support the FPU.

config ARCH_DPFPU
	bool "Double precision FPU support"
	default y
	depends on ARCH_FPU && ARCH_HAVE_DPFPU
	---help---
		Enable toolchain support for double precision (64-bit) floating
		point if both the toolchain and the hardware support it.

config ARCH_HAVE_TRUSTZONE
	bool
	default n
	---help---
		Automatically selected to indicate that the ARM CPU supports
		TrustZone.

choice
	prompt "TrustZone Configuration"
	default ARCH_TRUSTZONE_SECURE
	depends on ARCH_HAVE_TRUSTZONE

config ARCH_TRUSTZONE_SECURE
	bool "All CPUs operate secure state"

config ARCH_TRUSTZONE_NONSECURE
	bool "All CPUs operate non-secure state"
	depends on EXPERIMENTAL

config ARCH_TRUSTZONE_BOTH
	bool "CPUs operate in both secure and non-secure states"
	depends on EXPERIMENTAL

endchoice # TrustZone Configuration

config ARM_HAVE_MPU_UNIFIED
	bool
	default n
	---help---
		Automatically selected to indicate that the CPU supports a
		unified MPU for both instruction and data addresses.

config ARM_MPU
	bool "MPU support"
	default n
	depends on ARCH_HAVE_MPU
	select ARCH_USE_MPU
	---help---
		Build in support for the ARM Cortex-M3/4 Memory Protection Unit (MPU).
		Check your chip specifications first; not all Cortex-M3/4 chips
		support the MPU.

config ARM_MPU_NREGIONS
	int "Number of MPU regions"
	default 16 if ARCH_CORTEXM7
	default 8 if !ARCH_CORTEXM7
	depends on ARM_MPU
	---help---
		This is the number of protection regions supported by the MPU.

config ARCH_HAVE_LOWVECTORS
	bool

config ARCH_LOWVECTORS
	bool "Vectors in low memory"
	default n
	depends on ARCH_HAVE_LOWVECTORS
	---help---
		Support ARM vectors in low memory.

config ARCH_ROMPGTABLE
	bool "ROM page table"
	default n
	depends on ARCH_USE_MMU
	---help---
		Support a fixed memory mapping use a (read-only) page table in ROM/FLASH.

config DEBUG_HARDFAULT
	bool "Verbose Hard-Fault Debug"
	default n
	depends on DEBUG_FEATURES && (ARCH_CORTEXM0 || ARCH_CORTEXM3 || ARCH_CORTEXM4 || ARCH_CORTEXM7)
	---help---
		Enables verbose debug output when a hard fault is occurs.  This verbose
		output is sometimes helpful when debugging difficult hard fault problems,
		but may be more than you typcially want to see.

if ARCH_CORTEXM0
source arch/arm/src/armv6-m/Kconfig
endif
if ARCH_CORTEXA5 || ARCH_CORTEXA8 || ARCH_CORTEXA9
source arch/arm/src/armv7-a/Kconfig
endif
if ARCH_CORTEXM3 || ARCH_CORTEXM4 || ARCH_CORTEXM7
source arch/arm/src/armv7-m/Kconfig
endif
if ARCH_CORTEXR4 || ARCH_CORTEXR4F || ARCH_CORTEXR5 || ARCH_CORTEXR5F || ARCH_CORTEX74 || ARCH_CORTEXR7F
source arch/arm/src/armv7-r/Kconfig
endif
if ARCH_ARM7TDMI || ARCH_ARM920T || ARCH_ARM926EJS || ARCH_ARM1136J || ARCH_ARM1156T2 || ARCH_ARM1176JZ
source arch/arm/src/arm/Kconfig
endif
if ARCH_CHIP_STM32
source arch/arm/src/stm32/Kconfig
endif
if ARCH_CHIP_STM32F0
source arch/arm/src/stm32f0/Kconfig
endif
if ARCH_CHIP_STM32F7
source arch/arm/src/stm32f7/Kconfig
endif
if ARCH_CHIP_STM32L4
source arch/arm/src/stm32l4/Kconfig
endif

endif # ARCH_ARM
```

## arch/arm/src/arm/Kconfig
```kconfig
#
# For a description of the syntax of this configuration file,
# see the file kconfig-language.txt in the tools repository.
#

comment "ARM Configuration Options"

choice
	prompt "Toolchain Selection"
	default ARM_TOOLCHAIN_GNU_EABIL

config ARM_TOOLCHAIN_CODESOURCERYL
	bool "CodeSourcery GNU toolchain under Linux"
	depends on HOST_LINUX
	---help---
		For use with the GNU toolchain built package.

config ARM_TOOLCHAIN_GNU_EABIL
	bool "Generic GNU EABI toolchain under Linux (or other POSIX environment)"
	---help---
		This option should work for any modern GNU toolchain (GCC 4.5 or newer)
		configured for arm-none-eabi-.

config ARM_TOOLCHAIN_GNU_OABI
	bool "Generic GNU OABI toolchain"
	---help---
		This option should work for any GNU toolchain configured for arm-elf-.

endchoice
```

## arch/arm/src/armv6-m/Kconfig
```kconfig
#
# For a description of the syntax of this configuration file,
# see the file kconfig-language.txt in the tools repository.
#

comment "ARMV6M Configuration Options"

choice
	prompt "Toolchain Selection"
	default ARMV6M_TOOLCHAIN_GNU_EABIL

config ARMV6M_TOOLCHAIN_CODEREDL
	bool "CodeRed for Linux"
	depends on HOST_LINUX
	select ARCH_TOOLCHAIN_GNU

config ARMV6M_TOOLCHAIN_CODESOURCERYL
	bool "CodeSourcery GNU toolchain under Linux"
	depends on HOST_LINUX
	select ARCH_TOOLCHAIN_GNU

config ARMV6M_TOOLCHAIN_GNU_EABIL
	bool "Generic GNU EABI toolchain under Linux (or other POSIX environment)"
	select ARCH_TOOLCHAIN_GNU
	---help---
		This option should work for any modern GNU toolchain (GCC 4.5 or newer)
		configured for arm-none-eabi.

endchoice
```

## configs/Kconfig
```kconfig
#
# For a description of the syntax of this configuration file,
# see the file kconfig-language.txt in the tools repository.
#

choice
	prompt "Select target board"
	default ARCH_BOARD_STM32F103_MINIMUM
	---help---
		Select the board hosting the architecture.  You must first select the
		exact MCU part number, then the boards supporting that part will
		be available for selection.  Use ARCH_BOARD_CUSTOM to create a new
		board configuration.

config ARCH_BOARD_STM32F103_MINIMUM
	bool "STM32F103C8T6 Minimum ARM Development Board"
	depends on ARCH_CHIP_STM32F103C8
	---help---
		A configuration for the STM32F103 Minimum board.

endchoice

config ARCH_BOARD
	string
	default "stm32f103-minimum"        if ARCH_BOARD_STM32F103_MINIMUM

if ARCH_BOARD_STM32F103_MINIMUM
source "configs/stm32f103-minimum/Kconfig"
endif
```
