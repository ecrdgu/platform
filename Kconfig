## configs/stm32f103-minimum/hello/defconfig
```kconfig
CONFIG_HOST_LINUX=y
CONFIG_DEBUG_FULLOPT=y
CONFIG_ARCH_BOARD="stm32f103-minimum"
CONFIG_ARCH_BOARD_STM32F103_MINIMUM=y
CONFIG_ARCH_CHIP_STM32F103C8=y
CONFIG_ARCH_CHIP_STM32=y
CONFIG_ARMV7M_CMNVECTOR=y
CONFIG_BINFMT_DISABLE=y
CONFIG_BOARD_LOOPSPERMSEC=5483
CONFIG_DEFAULT_SMALL=y
```
